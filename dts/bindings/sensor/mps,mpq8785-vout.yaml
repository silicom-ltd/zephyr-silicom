## dts/bindings/sensor/mps,mpq8785-vout.yaml
```yaml
# Copyright (c) 2025 Silicom Connectivity Solutions, Ltd.
# SPDX-License-Identifier: Apache-2.0

description: VOUT measurement of PMBus device for MPQ8785

compatible: "mps,mpq8785-vout"

include: [pmbus.yaml, sensor-device.yaml]

on-bus: mpq8785
```

## dts/bindings/sensor/ocp,crps-iout.yaml
```yaml
# Copyright (c) 2025 Silicom Connectivity Solutions, Ltd.
# SPDX-License-Identifier: Apache-2.0

description: Current measurement of PMBus device for CRPS

compatible: "ocp,crps-iout"

include: [pmbus.yaml, sensor-device.yaml]

on-bus: crps
```

## dts/bindings/sensor/ocp,crps-power.yaml
```yaml
# Copyright (c) 2025 Silicom Connectivity Solutions, Ltd.
# SPDX-License-Identifier: Apache-2.0

description: Power measurement of PMBus device for CRPS

compatible: "ocp,crps-power"

include: [pmbus.yaml, sensor-device.yaml]

on-bus: crps
```

## dts/bindings/sensor/ocp,crps-temp.yaml
```yaml
# Copyright (c) 2025 Silicom Connectivity Solutions, Ltd.
# SPDX-License-Identifier: Apache-2.0

description: TEMP measurement of PMBus device for CRPS

compatible: "ocp,crps-temp"

include: [pmbus.yaml, sensor-device.yaml]

on-bus: crps

properties:
  temp-reg:
    type: int
    required: true
    enum:
      - 141
      - 142
```

## dts/bindings/sensor/x86-peci-temp.yaml
```yaml
# Read CPU temperature via PECI bus

description: |
  Sensor driver for reading CPU temperature via PECI.

compatible: "x86-peci-temp"

include: "base.yaml"

properties:
  peci-dev:
    type: phandle
    required: true
    description: |
      PECI device to read temperature from.
```

## dts/bindings/sensor/zephyr,i2c-target-lm75.yaml
```yaml
# SPDX-License-Identifier: Apache-2.0

description: Zephyr I2C target LM75 

compatible: "zephyr,i2c-target-lm75"

include: ["lm75-base.yaml", i2c-device.yaml]
```

## dts/bindings/smbus/microchip,xec-smbus.yaml
```yaml
# Copyright (c) 2025 Silicom Connectivity Solutions, Ltd.
# SPDX-License-Identifier: Apache-2.0

description: XEC SMBus controller

compatible: "microchip,xec-smbus"

include: [smbus-controller.yaml, pinctrl-device.yaml]

properties:
  i2c:
    type: phandle
    required: true
    description: I2C device which maps to the same address
```
