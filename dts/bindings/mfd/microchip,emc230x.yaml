## dts/bindings/sensor/mps,mp2985-iout.yaml
```yaml
# Copyright (c) 2025 Silicom Connectivity Solutions, Ltd.
# SPDX-License-Identifier: Apache-2.0

description: IOUT measurement of PMBus device for MP2985

compatible: "mps,mp2985-iout"

include: [pmbus.yaml, sensor-device.yaml]

on-bus: mp2985
```

## dts/bindings/sensor/mps,mpq8655-vin.yaml
```yaml
# Copyright (c) 2026 Silicom Connectivity Solutions, Ltd.
# SPDX-License-Identifier: Apache-2.0

description: VIN measurement of PMBus device for MPQ8655

compatible: "mps,mpq8655-vin"

include: [pmbus.yaml, sensor-device.yaml]

on-bus: mpq8655
```

## dts/bindings/sensor/mps,mpq8655-vout.yaml
```yaml
# Copyright (c) 2026 Silicom Connectivity Solutions, Ltd.
# SPDX-License-Identifier: Apache-2.0

description: VOUT measurement of PMBus device for MPQ8655

compatible: "mps,mpq8655-vout"

include: [pmbus.yaml, sensor-device.yaml]

on-bus: mpq8655
```

## dts/bindings/sensor/mps,mpq8785-iout.yaml
```yaml
# Copyright (c) 2025 Silicom Connectivity Solutions, Ltd.
# SPDX-License-Identifier: Apache-2.0

description: IOUT measurement of PMBus device for MPQ8785

compatible: "mps,mpq8785-iout"

include: [pmbus.yaml, sensor-device.yaml]

on-bus: mpq8785
```

## dts/bindings/sensor/mps,mpq8785-temp.yaml
```yaml
# Copyright (c) 2025 Silicom Connectivity Solutions, Ltd.
# SPDX-License-Identifier: Apache-2.0

description: TEMP measurement of PMBus device for MPQ8785

compatible: "mps,mpq8785-temp"

include: [pmbus.yaml, sensor-device.yaml]

on-bus: mpq8785
```

## dts/bindings/sensor/mps,mpq8785-vin.yaml
```yaml
# Copyright (c) 2025 Silicom Connectivity Solutions, Ltd.
# SPDX-License-Identifier: Apache-2.0

description: VIN measurement of PMBus device for MPQ8785

compatible: "mps,mpq8785-vin"

include: [pmbus.yaml, sensor-device.yaml]

on-bus: mpq8785
```
