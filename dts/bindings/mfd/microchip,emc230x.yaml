## dts/bindings/mfd/microchip,emc230x.yaml
```yaml
# Copyright (c) 2025 Silicom Connectivity Solutions, Ltd.
# SPDX-License-Identifier: Apache-2.0

description: Microchip EMC230X 1/2/3/5-channel I2C-bus PWM controller, MFD device

compatible: "microchip,emc230x"

include: i2c-device.yaml

bus: emc230x

properties:
  reg:
    required: true
```

## dts/bindings/mfd/mps,mp2928.yaml
```yaml
# Copyright (c) 2025 Silicom Connectivity Solutions, Ltd.
# SPDX-License-Identifier: Apache-2.0

description: Monolithic MP2928 Digital controller PMBus MFD device

compatible: "mps,mp2928"

include: smbus-device.yaml

bus: mp2928

properties:
  reg:
    required: true
```

## dts/bindings/mfd/mps,mp2985.yaml
```yaml
# Copyright (c) 2025 Silicom Connectivity Solutions, Ltd.
# SPDX-License-Identifier: Apache-2.0

description: Monolithic MP2985 Digital controller PMBus MFD device

compatible: "mps,mp2985"

include: smbus-device.yaml

bus: mp2985

properties:
  reg:
    required: true
```

## dts/bindings/mfd/mps,mpq8655.yaml
```yaml
# Copyright (c) 2026 Silicom Connectivity Solutions, Ltd.
# SPDX-License-Identifier: Apache-2.0

description: Monolithic Power Systems MPQ8655 step-down converter PMBus MFD device

compatible: "mps,mpq8655"

include: smbus-device.yaml

bus: mpq8655

properties:
  reg:
    required: true
```

## dts/bindings/mfd/mps,mpq8785.yaml
```yaml
# Copyright (c) 2025 Silicom Connectivity Solutions, Ltd.
# SPDX-License-Identifier: Apache-2.0

description: Monolithic MPQ8785 Step down converter PMBus MFD device

compatible: "mps,mpq8785"

include: i2c-device.yaml

properties:
  reg:
    required: true
```

## dts/bindings/mfd/ocp,crps.yaml
```yaml
# Copyright (c) 2025 Silicom Connectivity Solutions, Ltd.
# SPDX-License-Identifier: Apache-2.0

description: Open Compute Project Common Redundant Power Supply

compatible: "ocp,crps"

include: smbus-device.yaml

bus: crps

properties:
  reg:
    required: true
```

## dts/bindings/mtd/microchip,xec-maf-flash.yaml
```yaml
description: |
  XEC MAF flash memory. This binding is for the flash memory itself, not
  the flash controller peripheral.

include: soc-nv-flash.yaml

compatible: microchip,xec-maf-flash

properties:

  max-sectors:
    type: int
    description: max number of flash sectors in the MCU region
    required: true
```

## dts/bindings/pwm/maxim,max31785-fan.yaml
```yaml
# Copyright (c) 2026 Silicom Connectivity Solutions, Ltd.
# SPDX-License-Identifier: Apache-2.0

description: Maxim MAX31785 Fan

compatible: "maxim,max31785-fan"

include: base.yaml

on-bus: max31785

child-binding:
  properties:
    page:
      required: true
      type: int

    mode:
      required: true
      type: string
      enum:
        - FAN_AUTO_PWM
        - FAN_AUTO_RPM
        - FAN_MANUAL_PWM
        - FAN_MANUAL_RPM
    hyst:
      type: int
      description: |
        Temperature hysteresis for fan control table.
      default: 2
      enum: [2, 4, 6, 8]

    ppr:
      required: true
      type: int
      description: |
        Tach Pulses Per Revolution.
      default: 2
      enum: [1, 2, 3, 4]

    locked-rotor-en:
      type: boolean
      description: |
        If set, the fan outputs a locked-rotor indicator on TACH instead
        of a tach signal (MFR_FAN_CONFIG ROTOR). If unset (the default),
        TACH is treated as a normal tachometer input.

    locked-rotor-active-high:
      type: boolean
      description: |
        Polarity of the locked-rotor signal on TACH, if locked-rotor-en is
        set (MFR_FAN_CONFIG ROTOR_HI_LO). Ignored if locked-rotor-en is
        unset. If unset (the default), the signal is active-low (TACH is
        low if the rotor stops); if set, active-high (TACH is high if the
        rotor stops).

    pwm-frequency:
      type: int
      description: |
        Fan PWM output frequency in Hz (MFR_FAN_CONFIG FREQ). This device
        does not support pulse stretching.
      default: 30
      enum: [30, 50, 100, 150, 25000]

    dual-tach-enable:
      type: boolean
      description: |
        Enable dual-tachometer support for this fan (MFR_FAN_CONFIG
        DUAL_TACH). In dual-tach applications it is recommended that the
        slower of the two tachometer signals be presented to TACH when
        TACHSEL = 0.

    fan-fault-hold-last-value:
      type: boolean
      description: |
        If set, ignore a temperature sensor fault or a stale
        FAN_COMMAND_1 update and hold the last updated PWM/RPM value
        (MFR_FAN_CONFIG TSFO) -- in automatic mode, the fan is instead
        driven by whichever of its other assigned temperature sensors
        are still valid, if any. If unset (the default), ramp to 100%
        PWM duty cycle instead: on a temp sensor fault in automatic mode,
        or if no FAN_COMMAND_1 update occurs within 10s in manual mode.

    fan-fault-no-ramp:
      type: boolean
      description: |
        If set, do not ramp the fan to 100% PWM duty cycle when a fan
        fault (MFR_FAN_FAULT_LIMIT violation or a locked rotor) is
        detected -- just report it; normal operation resumes
        automatically once the fault clears (MFR_FAN_CONFIG TACHO). If
        unset (the default), ramp to 100% while the fault is active.

    fan-ramp-time-ds:
      type: int
      description: |
        Time, in deciseconds (tenths of a second), to ramp fan PWM duty
        cycle from 40% to 100% (MFR_FAN_CONFIG RAMP). This jointly sets the
        PWM duty cycle update rate (200ms or 1000ms) and the maximum duty
        cycle change allowed per update (1-5%); see the datasheet's
        MFR_FAN_CONFIG RAMP table for the full breakdown. In RPM mode, the
        device additionally caps the change to 1% once within 20% of the
        target speed, and stops changing once within 5% of it.
      default: 600
      enum: [600, 300, 200, 120, 60, 40, 30, 24]

    spinup-revs:
      type: int
      description: |
        Number of tach revolutions to wait for before confirming the fan
        has spun up (MFR_FAN_CONFIG SPIN). A value of 0 disables spin-up
        confirmation entirely.
      default: 0
      enum: [0, 2, 4, 8]

    health-meter-enable:
      type: boolean
      description: |
        Enable the fan-health-diagnostic function (MFR_FAN_CONFIG HEALTH).
        Compares measured vs. expected fan speed (see MFR_FAN_PWM2RPM) to
        set the GREEN/ORANGE/RED/YELLOW health bits in STATUS_FANS_1_2.
        This is a predictive diagnostic, separate from the
        fan-fault-hold-last-value/fan-fault-no-ramp fault handling above.

    fan-speeds:
      type: array
      description: |
        Array of speeds per temperature for this fan.

    fan-temps:
      type: array
      description: |
        Array of temperatures per speed for this fan.

    initial-setting:
      type: int
      description: |
        Initial setting of fan, either PWM % or RPM, depending on mode setting
```

## dts/bindings/pwm/microchip,emc230x-pwm.yaml
```yaml
# Copyright (c) 2025 Silicom Connectivity Solutions, Ltd.
# SPDX-License-Identifier: Apache-2.0

description: Microchip EMC230X 1/2/3/5-channel I2C-bus PWM controller

compatible: "microchip,emc230x-pwm"

include: [pwm-controller.yaml, base.yaml]

properties:
  "#pwm-cells":
    const: 2

child-binding:
  properties:
    pwms:
      required: true
      type: phandle-array

    tach:
      required: false
      type: phandle

    edges:
      required: true
      type: int

    initial:
      required: false
      type: int

pwm-cells:
  - channel
  - period
```

## dts/bindings/pwm/microchip,xec-rpm2pwm.yaml
```yaml
# Copyright (c) 2023, Silicom Connectivity Solutions, Ltd.
# SPDX-License-Identifier: Apache-2.0

description: |

  Microchip XEC RPM2PWM

  Microchip's MEC172x series of embedded controllers supports up to 2 closed loop fan controllers.
  The fan controllers use an input tachometer reading and a target RPM to control the PWM to the
  fans.  There are multiple fan type configurations to support fans with different numbers of poles
  in order to read the RPM correctly, as well as options to control the fan ramp up/down and
  startup spin control.

  This driver is an initial baseline requesting review and comment on the design and feature-set.

  Example DTS board configuration:

  &rpmfan0 {
          pinctrl-0 = <&gpwm0_gpio53 &gtach_gpio050>;
          pinctrl-names = "default";
          status = "okay";

          rpmfantach0: {
                  status = "okay";
          }

          fan {
                  fan0: fan {
                          pwms = <&rpmfan0 0 PWM_MSEC(30) 0>;
                          edges = <5>;
                  };
          };
  };

include: [pwm-controller.yaml, base.yaml, pinctrl-device.yaml]

compatible: "microchip,xec-rpm2pwm"

properties:
  reg:
    required: true

  pcrs:
    type: array
    required: true
    description: RPM2PWM PCR register index and bit position

  "#pwm-cells":
    const: 3

  girqs:
    type: array
    required: true
    description: |
      Array of encoded interrupt information

  pinctrl-0:
    required: true

  pinctrl-names:
    required: true

  gain:
    type: array
    required: false
    description: |
      Array of proportional/integral/derivative gain for fan speed control.  Values can only be 1,2,4,8.

  der_opts:
    type: string
    required: false
    description: |
      Derivative options: 
      - RPM2PWM_DERIVATIVE_NONE: No derivative option
      - RPM2PWM_DERIVATIVE_BASIC: Basic derivative of error added to PWM drive
      - RPM2PWM_DERIVATIVE_STEP: Derivative is not limited by max step value
      - RPM2PWM_DERIVATIVE_BOTH: Use both Basic and Step derivative, doubling derivative effect
    enum:
      - "RPM2PWM_DERIVATIVE_NONE"
      - "RPM2PWM_DERIVATIVE_BASIC"
      - "RPM2PWM_DERIVATIVE_STEP"
      - "RPM2PWM_DERIVATIVE_BOTH"

  update:
    type: string
    required: false
    description: |
      Update times:
      - RPM2PWM_UPDATE_100MS: 100ms update period
      - RPM2PWM_UPDATE_200MS: 200ms update period
      - RPM2PWM_UPDATE_300MS: 300ms
      - RPM2PWM_UPDATE_400MS: etc
      - RPM2PWM_UPDATE_500MS:
      - RPM2PWM_UPDATE_800MS:
      - RPM2PWM_UPDATE_1200MS:
      - RPM2PWM_UPDATE_1600MS:
    enum:
      - "RPM2PWM_UPDATE_100MS"
      - "RPM2PWM_UPDATE_200MS"
      - "RPM2PWM_UPDATE_300MS"
      - "RPM2PWM_UPDATE_400MS"
      - "RPM2PWM_UPDATE_500MS"
      - "RPM2PWM_UPDATE_800MS"
      - "RPM2PWM_UPDATE_1200MS"
      - "RPM2PWM_UPDATE_1600MS"

  spinup_time:
    type: string
    required: false
    description: |
      Time the spin-up function runs for.
    enum:
      - "RPM2PWM_SPINUP_250MS"
      - "RPM2PWM_SPINUP_500MS"
      - "RPM2PWM_SPINUP_1S"
      - "RPM2PWM_SPINUP_2S"

  spinup_level:
    type: string
    required: false
    description: |
      Drive level used by the spinup routine
    enum:
      - "RPM2PWM_SPINUP_LVL_30%"
      - "RPM2PWM_SPINUP_LVL_35%"
      - "RPM2PWM_SPINUP_LVL_40%"
      - "RPM2PWM_SPINUP_LVL_45%"
      - "RPM2PWM_SPINUP_LVL_50%"
      - "RPM2PWM_SPINUP_LVL_55%"
      - "RPM2PWM_SPINUP_LVL_60%"
      - "RPM2PWM_SPINUP_LVL_65%"

  spinup_nokick:
    type: boolean
    description: |
      If nokick is enabled, the PWM will not be driven to 100% for the spinup time.

  spinup_drive_fail:
    type: string
    description: |
      How many update cycles for drive fail detection.
    enum:
      - "RPM2PWM_SPINUP_DRIVEFAIL_DISABLED"
      - "RPM2PWM_SPINUP_DRIVEFAIL_16"
      - "RPM2PWM_SPINUP_DRIVEFAIL_32"
      - "RPM2PWM_SPINUP_DRIVEFAIL_64"

  enable_ramp_control:
    type: boolean
    description: |
      For manual control of fan speed, enable this. 

  manual_mode:
    type: boolean
    description: |
      Manual (PWM duty cycle) control of the fan IP

child-binding:
  child-binding:
    properties:
      pwms:
        required: true
        type: phandle-array
        description: |
          Reference to RPM2PWM instance.

          The period field is ignored, period is fixed in hardware.  Flags
          should be used to set the desired spin-up and update period etc.
          of the rpm2pwm fan controller.

      edges:
        required: true
        type: int
        description: |
          Number of edges on this fan that are needed to count a single
          revolution.

pwm-cells:
  - channel
  - period
  - flags
```

## dts/bindings/sensor/fan-fault-controller.yaml
```yaml
# Copyright (c) 2025, Silicom Connectivity Solutions, Ltd.
# SPDX-License-Identifier: Apache-2.0

# Common fields for fan fault sensors

properties:
  "#fan-fault-cells":
    type: int
    required: true
    description: Number of items to expect in a fan-fault specifier
```

## dts/bindings/sensor/lm75-base.yaml
```yaml
# Copyright (c) 2026 Silicom Connectivity Solutions, Ltd
# SPDX-License-Identifier: Apache-2.0

# Common fields for LM75 firmware target devices

include: base.yaml

properties:
  target-sensor:
    type: phandle
    description: Source sensor device.

  target-period:
    type: int
    description: Sample period of sensor in milliseconds.

  failsafe-temp-millic:
    type: int
    default: 32000
    description: |
      Temperature, in millidegrees Celsius, to report over I2C while the
      power domain supplying target-sensor is off (PM_DEVICE_ACTION_TURN_OFF)
      and target-sensor can no longer be read. Defaults to 32000
      (32.000 deg C).
```

## dts/bindings/sensor/maestro-switch-temp.yaml
```yaml
# Copyright (c) 2026 Silicom Connectivity Solutions, Ltd.
# SPDX-License-Identifier: Apache-2.0

description: TEMP measurement of Maestro switch

compatible: "maestro-switch-temp"

include: [i2c-device.yaml, sensor-device.yaml]
```

## dts/bindings/sensor/maxim,max31785-dts.yaml
```yaml
# Copyright (c) 2026 Silicom Connectivity Solutions, Ltd.
# SPDX-License-Identifier: Apache-2.0

description: Maxim MAX31785 Digital Temperature Sensor

compatible: "maxim,max31785-dts"

child-binding:
  properties:
    fans:
      type: phandles
      description: |
        List of Fan phandles that this DTS affects.
```

## dts/bindings/sensor/microchip,emc230x-fan-fault.yaml
```yaml
# Copyright (c) 2025 Silicom Connectivity Solutions, Ltd.
# SPDX-License-Identifier: Apache-2.0

description: fan fault measurement of Microchip EMC230X PWM Controller

include: [sensor-device.yaml, fan-fault-controller.yaml]

compatible: "microchip,emc230x-fan-fault"

on-bus: emc230x

properties:

  "#fan-fault-cells":
  const: 2

fan-fault-cells:
  - channel
  - flags
```

## dts/bindings/sensor/microchip,emc230x-fan-speed.yaml
```yaml
# Copyright (c) 2025 Silicom Connectivity Solutions, Ltd.
# SPDX-License-Identifier: Apache-2.0

description: fan speed measurement of Microchip EMC230X PWM Controller

compatible: "microchip,emc230x-fan-speed"

include: [sensor-device.yaml]

on-bus: emc230x

properties:
  channel:
    type: int
    enum:
      - 0
      - 1
      - 2
      - 3
      - 4
      - 5
    required: true
    description: PWM channel number
```

## dts/bindings/sensor/mps,mp2928-iout.yaml
```yaml
# Copyright (c) 2025 Silicom Connectivity Solutions, Ltd.
# SPDX-License-Identifier: Apache-2.0

description: IOUT measurement of PMBus device for MP2928

compatible: "mps,mp2928-iout"

include: [pmbus.yaml, sensor-device.yaml]

on-bus: mp2928
```

## dts/bindings/sensor/mps,mp2928-temp.yaml
```yaml
# Copyright (c) 2025 Silicom Connectivity Solutions, Ltd.
# SPDX-License-Identifier: Apache-2.0

description: TEMP measurement of PMBus device for MP2928

compatible: "mps,mp2928-temp"

include: [pmbus.yaml, sensor-device.yaml]

on-bus: mp2928
```

## dts/bindings/sensor/mps,mp2928-vout.yaml
```yaml
# Copyright (c) 2025 Silicom Connectivity Solutions, Ltd.
# SPDX-License-Identifier: Apache-2.0

description: VOUT measurement of PMBus device for MP2928

compatible: "mps,mp2928-vout"

include: [pmbus.yaml, sensor-device.yaml]

on-bus: mp2928
```
