## drivers/i2c/Kconfig.xec
```kconfig
# Microchip XEC I2C configuration options

# Copyright (c) 2019 Intel Corporation
# SPDX-License-Identifier: Apache-2.0

config I2C_XEC
	bool "XEC Microchip I2C driver"
	default y
	depends on DT_HAS_MICROCHIP_XEC_I2C_ENABLED
	help
	  Enable the Microchip XEC I2C driver.

config I2C_XEC_V2
	bool "XEC Microchip I2C driver"
	default y
	depends on DT_HAS_MICROCHIP_XEC_I2C_V2_ENABLED
	help
	  Enable the Microchip XEC I2C V2 driver. This driver uses the
	  controller's legacy byte-at-a-time register interface, polling the
	  PIN status bit for every byte transferred. An instance that should
	  instead be driven by I2C_XEC_V2_NL uses the
	  "microchip,xec-i2c-v2-nl" compatible rather than this one.

config I2C_XEC_V2_NL
	bool "XEC Microchip I2C network-layer (DMA) driver"
	default y
	depends on DT_HAS_MICROCHIP_XEC_I2C_V2_NL_ENABLED
	select DMA
	help
	  Enable the Microchip XEC I2C V2 network-layer driver. This driver
	  uses the controller's hardware Master Command state machine and an
	  external DMA channel to move transaction data, signaling completion
	  with one or two interrupts per transaction instead of polling every
	  byte. It claims instances whose devicetree node uses the
	  "microchip,xec-i2c-v2-nl" compatible.
```

## drivers/i2c/target/Kconfig.lm75
```kconfig
# I2C LM75 Target configuration options

# Copyright (c) 2026 Silicom Connectivity Solutions, Ltd.
# SPDX-License-Identifier: Apache-2.0

config I2C_LM75_TARGET
	bool "I2C Target LM75 driver"
	default y
	depends on DT_HAS_ZEPHYR_I2C_TARGET_LM75_ENABLED
	help
	  Enable virtual I2C Target LM75 driver

config LM75_TARGET_INIT_PRIORITY
	int "LM75 target init priority"
	default 91
	depends on I2C_LM75_TARGET
	help
	  Priority init level of LM75 target, needs to be higher than sensor
	  init level.
```

## drivers/mfd/Kconfig.crps
```kconfig
# Copyright (c) 2025 Silicom Connectivity Solutions, Ltd.
# SPDX-License-Identifier: Apache-2.0

config MFD_CRPS
	bool "Open Compute Project Common Redundant Power Supply"
	default y
	depends on DT_HAS_OCP_CRPS_ENABLED
	select I2C
	select SMBUS
	select PMBUS
	help
	  Enable driver for OCP CRPS.

config MFD_CRPS_INIT_PRIORITY
	int "crps MFD initialization priority"
	default MFD_INIT_PRIORITY
	depends on MFD_CRPS
	help
	  Mult-function device initialization priority for crps.
```

## drivers/mfd/Kconfig.emc230x
```kconfig
# Copyright (c) 2025 Silicom Connectivity Solutions, Ltd.
# SPDX-License-Identifier: Apache-2.0

config MFD_EMC230X
	bool "Microchip EMC230X I2C configurable PWM controller"
	default y
	depends on DT_HAS_MICROCHIP_EMC230X_ENABLED
	select I2C
	help
	  Enable driver for Microchip EMC230X.
```

## drivers/mfd/Kconfig.max31785
```kconfig
# Copyright (c) 2026 Silicom Connectivity Solutions, Ltd.
# SPDX -License-Identifier: Apache-2.0

config MFD_MAX31785
	bool "MAX31785 MFD device driver"
	default y
	depends on DT_HAS_MAXIM_MAX31785_ENABLED
	select I2C
	select SMBUS
	select PMBUS
	help
	  Enable the Maxim MAX21785 MFD device driver
```

## drivers/mfd/Kconfig.mp2928
```kconfig
# Copyright (c) 2025 Silicom Connectivity Solutions, Ltd.
# SPDX-License-Identifier: Apache-2.0

config MFD_MP2928
	bool "Monolithic Power Systems MP2928 Digital Controller"
	default y
	depends on DT_HAS_MPS_MP2928_ENABLED
	select I2C
	select SMBUS
	select PMBUS
	help
	  Enable driver for MPS MP2928

config MFD_MP2928_INIT_PRIORITY
	int "mp2928 MFD initialization priority"
	default MFD_INIT_PRIORITY
	depends on MFD_MP2928
	help
	  Mult-function device initialization priority for mp2928.
```

## drivers/mfd/Kconfig.mp2985
```kconfig
# Copyright (c) 2025 Silicom Connectivity Solutions, Ltd.
# SPDX-License-Identifier: Apache-2.0

config MFD_MP2985
	bool "Monolithic Power Systems MP2985 Digital Controller"
	default y
	depends on DT_HAS_MPS_MP2985_ENABLED
	select I2C
	select SMBUS
	select PMBUS
	help
	  Enable driver for MPS MP2985

config MFD_MP2985_INIT_PRIORITY
	int "mp2985 MFD initialization priority"
	default MFD_INIT_PRIORITY
	depends on MFD_MP2985
	help
	  Mult-function device initialization priority for mp2985.
```

## drivers/mfd/Kconfig.mpq8655
```kconfig
# Copyright (c) 2026 Silicom Connectivity Solutions, Ltd.
# SPDX-License-Identifier: Apache-2.0

config MFD_MPQ8655
	bool "Monolithic Power Systems MPQ8655 Digital Controller"
	default y
	depends on DT_HAS_MPS_MPQ8655_ENABLED
	select I2C
	select SMBUS
	select PMBUS
	help
	  Enable driver for MPS MPQ8655

config MFD_MPQ8655_INIT_PRIORITY
	int "MPQ8655 MFD initialization priority"
	default MFD_INIT_PRIORITY
	depends on MFD_MPQ8655
	help
	  Multi-function device initialization priority for MPQ8655.
```

## drivers/mfd/Kconfig.mpq8785
```kconfig
# Copyright (c) 2025 Silicom Connectivity Solutions, Ltd.
# SPDX-License-Identifier: Apache-2.0

config MFD_MPQ8785
	bool "Moonolithic MPQ8785 PMBus step down converter"
	default y
	depends on DT_HAS_MICROCHIP_MPQ8785_ENABLED
	select I2C
	select SMBUS
	select PMBUS
	help
	  Enable driver for Monolithic MPQ8785.

config MFD_MPQ8785_INIT_PRIORITY
	int "mpq8785 MFD initialization priority"
	default MFD_INIT_PRIORITY
	depends on MFD_MPQ8785
	help
	  Mult-function device initialization priority for mpq8785.
```

## drivers/pmbus/Kconfig
```kconfig
# SMBus configuration options

# Copyright (c) 2025 Intel Corporation
# SPDX-License-Identifier: Apache-2.0

menuconfig PMBUS
	bool "Power Management Bus (PMBus) drivers"
	depends on SMBUS
	help
	  Enable PMBus Driver Configuration

module = PMBUS
module-str = pmbus
source "subsys/logging/Kconfig.template.log_config"
```

## drivers/pwm/Kconfig.emc230x
```kconfig
#
# Copyright (c) 2025 Silicom Connectivity Solutions, Ltd.
#
# SPDX-License-Identifier: Apache-2.0
#

config PWM_EMC230X
	bool "EMC230X 1/2/3/5-channel I2C-bus PWM controller"
	default y
	depends on DT_HAS_MICROCHIP_EMC230X_PWM_ENABLED
	select MFD
	help
	  Enable driver for EMC230X 1/2/3/5-channel I2C-bus PWM controller.
```

## drivers/pwm/Kconfig.max31785
```kconfig
# Copyright (c) 2026 Silicom Connectivity Solutions, Ltd.
# SPDX -License-Identifier: Apache-2.0

config FAN_MAX31785
	bool "MAX31785 Fan control device driver"
	default y
	depends on DT_HAS_MAXIM_MAX31785_FAN_ENABLED
	select MFD
	select I2C
	select SMBUS
	select PMBUS
	help
	  Enable the Maxim MAX21785 fan control device driver

if FAN_MAX31785

config FAN_MAXIM_MAX31785_COMMON_INIT_PRIORITY
	int "MAX31785 fan driver init priority (common part)"
	default 86
	help
	  Init priority for the Maxim MAX31785 fan driver
	  (common part).  It must be greater than I2C and MFD init priority.

config FAN_MAXIM_MAX31785_INIT_PRIORITY
	int "MAX31785 fan driver init priority"
	default 87
	help
	  Init priority for the Maxim MAX31785 fan driver. It must be
	  greater than FAN_MAXIM_MAX31785_COMMON_INIT_PRIORITY

endif
```

## drivers/sensor/crps/Kconfig
```kconfig
# Copyright (c) 2025 Silicom Connectivity Solutions, Ltd.
# SPDX-License-Identifier: Apache-2.0

config CRPS_SENSOR
	bool "CRPS sensors"
	default y
	depends on CRPS_TEMP || CRPS_POWER || CRPS_IOUT
	help
	  Enable sensors for the CRPS Temperature sensorr.

config CRPS_POWER
	bool "CRPS Power output"
	default y
	depends on DT_HAS_OCP_CRPS_POWER_ENABLED
	select MFD
	help
	  Enable driver for the CRPS POWER sensor.

config CRPS_VOUT
	bool "MPQ8785 Voltage output"
	default y
	depends on DT_HAS_OCP_CRPS_VOUT_ENABLED
	select MFD
	help
	  Enable driver for the MPQ8785 VOUT sensor.

config CRPS_IOUT
	bool "CRPS Current output"
	default y
	depends on DT_HAS_OCP_CRPS_IOUT_ENABLED
	select MFD
	help
	  Enable driver for the CRPS IOUT sensor.

config CRPS_TEMP
	bool "CRPS Temperature reading"
	default y
	depends on DT_HAS_OCP_CRPS_TEMP_ENABLED
	select MFD
	help
	  Enable driver for the CRPS TEMP sensor.
```

## drivers/sensor/emc230x/Kconfig
```kconfig
# Copyright (c) 2025 Silicom Connectivity Solutions, Ltd.
# SPDX-License-Identifier: Apache-2.0

config EMC230X_SENSOR
	bool "EMC230X sensors"
	default y
	depends on EMC230X_FAN_SPEED || EMC230X_FAN_FAULT
	help
	  Enable sensors for the EMC230X PWM controller.

config EMC230X_FAN_SPEED
	bool "EMC230X fan speed sensor"
	default y
	depends on DT_HAS_MICROCHIP_EMC230X_FAN_SPEED_ENABLED
	select MFD
	help
	  Enable driver for the EMC230X fan speed sensor.

config EMC230X_FAN_FAULT
	bool "EMC230X fan fault sensor"
	default y
	depends on DT_HAS_MICROCHIP_EMC230X_FAN_FAULT_ENABLED
	select MFD
	help
	  Enable driver for the EMC230X fan fault sensor.
```

## drivers/sensor/maestro_cpld/Kconfig
```kconfig
# Copyright (c) 2026 Silicom Connectivity Solutions, Ltd.
# SPDX-License-Identifier: Apache-2.0

config MAESTRO_CPLD
	bool "Maestro CPLD sensors"
	default y
	depends on MAESTRO_SWITCH_TEMP
	help
	  Enable sensors for the Maestro CPLD.

config MAESTRO_SWITCH_TEMP
	bool "Maestro switch Temperature reading"
	default y
	depends on DT_HAS_MAESTRO_SWITCH_TEMP_ENABLED
	select MFD
	help
	  Enable driver for the Maestro switch TEMP sensor.
```

## drivers/sensor/max31785/Kconfig
```kconfig
# MAX31785 temperature sensor configuration options

# Copyright (c) 2026 Silicom Connectivity Solutions, Ltd.
# SPDX-License-Identifier: Apache-2.0

config MAX31785_DTS
	bool "MAX31785 sensor"
	default y
	depends on DT_HAS_MAXIM_MAX31785_DTS_ENABLED
	select I2C
	select SMBUS
	select PMBUS
	select MFD
	help
	  Enable driver for MAX31785 temperature sensor.

if MAX31785_DTS

config DTS_MAXIM_MAX31785_COMMON_INIT_PRIORITY
	int "MAX31785 temp sensor init priority (common part)"
	default 91
	help
	  Init priority for the Maxim MAX31785 temp driver
	  (common part).  It must be greater than SENSOR init priority.

config DTS_MAXIM_MAX31785_INIT_PRIORITY
	int "MAX31785 temp sensor init priority"
	default 92
	help
	  Init priority for the Maxim MAX31785 temp driver.  It must be
	  greater than DT_MAXIM_MAX31785_COMMON_INIT_PRIORITY.

endif
```

## drivers/sensor/mp2928/Kconfig
```kconfig
# Copyright (c) 2025 Silicom Connectivity Solutions, Ltd.
# SPDX-License-Identifier: Apache-2.0

config MP2928_SENSOR
	bool "MP2928 sensors"
	default y
	depends on MP2928_TEMP || MP2928_VOUT
	help
	  Enable sensors for the MP2928.

config MP2928_VOUT
	bool "MP2928 Voltage output"
	default y
	depends on DT_HAS_MPS_MP2928_VOUT_ENABLED
	select MFD
	help
	  Enable driver for the MP2928 VOUT sensor.

config MP2928_TEMP
	bool "MP2928 Temperature reading"
	default y
	depends on DT_HAS_MPS_MP2928_TEMP_ENABLED
	select MFD
	help
	  Enable driver for the MP2928 TEMP sensor.
```

## drivers/sensor/mp2985/Kconfig
```kconfig
# Copyright (c) 2025 Silicom Connectivity Solutions, Ltd.
# SPDX-License-Identifier: Apache-2.0

config MP2985_SENSOR
	bool "MP2985 sensors"
	default y
	depends on MP2985_TEMP || MP2985_VOUT || MP2985_IOUT || MP2985_VIN
	help
	  Enable sensors for the MP2985.

config MP2985_VOUT
	bool "MP2985 Voltage output"
	default y
	depends on DT_HAS_MPS_MP2985_VOUT_ENABLED
	select MFD
	help
	  Enable driver for the MP2985 VOUT sensor.

config MP2985_TEMP
	bool "MP2985 Temperature reading"
	default y
	depends on DT_HAS_MPS_MP2985_TEMP_ENABLED
	select MFD
	help
	  Enable driver for the MP2985 TEMP sensor.

config MP2985_IOUT
	bool "MP2985 Current output"
	default y
	depends on DT_HAS_MPS_MP2985_IOUT_ENABLED
	select MFD
	help
	  Enable driver for the MP2985 IOUT sensor.

config MP2985_VIN
	bool "MP2985 voltage input"
	default y
	depends on DT_HAS_MPS_MP2985_VIN_ENABLED
	select MFD
	help
	  Enable driver for the MP2985 VIN sensor.
```

## drivers/sensor/mpq8655/Kconfig
```kconfig
# Copyright (c) 2026 Silicom Connectivity Solutions, Ltd.
# SPDX-License-Identifier: Apache-2.0

config MPQ8655_SENSOR
	bool "MPQ8655 sensors"
	default y
	depends on MPQ8655_VOUT || MPQ8655_IOUT || MPQ8655_VIN || MPQ8655_TEMP
	help
	  Enable sensors for the MPQ8655.

config MPQ8655_VOUT
	bool "MPQ8655 Voltage output"
	default y
	depends on DT_HAS_MPS_MPQ8655_VOUT_ENABLED
	select MFD
	help
	  Enable driver for the MPQ8655 VOUT sensor.

config MPQ8655_IOUT
	bool "MPQ8655 Current output"
	default y
	depends on DT_HAS_MPS_MPQ8655_IOUT_ENABLED
	select MFD
	help
	  Enable driver for the MPQ8655 IOUT sensor.

config MPQ8655_VIN
	bool "MPQ8655 Voltage input"
	default y
	depends on DT_HAS_MPS_MPQ8655_VIN_ENABLED
	select MFD
	help
	  Enable driver for the MPQ8655 VIN sensor.

config MPQ8655_TEMP
	bool "MPQ8655 Temperature reading"
	default y
	depends on DT_HAS_MPS_MPQ8655_TEMP_ENABLED
	select MFD
	help
	  Enable driver for the MPQ8655 TEMP sensor.
```

## drivers/sensor/mpq8785/Kconfig
```kconfig
# Copyright (c) 2025 Silicom Connectivity Solutions, Ltd.
# SPDX-License-Identifier: Apache-2.0

config MPQ8785_SENSOR
	bool "MPQ8785 sensors"
	default y
	depends on MPQ8785_VIN || MPQ8785_VOUT || MPQ8785_IOUT || MPQ8785_TEMP
	help
	  Enable sensors for the MPQ8785 Step down converter.

config MPQ8785_VIN
	bool "MPQ8785 Voltage input"
	default y
	depends on DT_HAS_MPS_MPQ8785_VIN_ENABLED
	select MFD
	help
	  Enable driver for the MPQ8785 VIN sensor.

config MPQ8785_VOUT
	bool "MPQ8785 Voltage output"
	default y
	depends on DT_HAS_MPS_MPQ8785_VOUT_ENABLED
	select MFD
	help
	  Enable driver for the MPQ8785 VOUT sensor.

config MPQ8785_IOUT
	bool "MPQ8785 Current output"
	default y
	depends on DT_HAS_MPS_MPQ8785_IOUT_ENABLED
	select MFD
	help
	  Enable driver for the MPQ8785 IOUT sensor.

config MPQ8785_TEMP
	bool "MPQ8785 Temperature reading"
	default y
	depends on DT_HAS_MPS_MPQ8785_TEMP_ENABLED
	select MFD
	help
	  Enable driver for the MPQ8785 TEMP sensor.
```

## drivers/sensor/x86_peci_temp/Kconfig
```kconfig
# Copyright (c) 2026 Silicom Connectivity Solutions, Ltd
# SPDX-License-Identifier: Apache-2.0

config X86_PECI_TEMP
	bool "X86 PECI Temperature Sensor"
	default y
	depends on DT_HAS_X86_PECI_TEMP_ENABLED
	help
	  Enable driver for PECI temperature sensor on X86 targets.

if X86_PECI_TEMP

module = X86_PECI_TEMP
module-str = x86_peci_temp
source "subsys/logging/Kconfig.template.log_config"

endif # X86_PECI_TEMP
```

## dts/bindings/base/pmbus.yaml
```yaml
# Copyright (c) 2025 Silicom Connectivity Solutions, Ltd.
# SPDX-License-Identifier: Apache-2.0

# Properties for PMBus devices

properties:
  page:
    type: int
    required: true
    description: |
      The page that this PMBus sub-device is located.

  coefficients:
    type: array
    description: |
      Coefficients to determine the actual being reported by the output 
      registers of a PMBus device, given in terms of m, B, R for slope.
```
